/**************************************************************************
 This is an example for our Monochrome OLEDs based on SSD1306 drivers

 Pick one up today in the adafruit shop!
 ------> http://www.adafruit.com/category/63_98

 This example is for a 128x64 pixel display using I2C to communicate
 3 pins are required to interface (two I2C and one reset).

 Adafruit invests time and resources providing this open
 source code, please support Adafruit and open-source
 hardware by purchasing products from Adafruit!

 Written by Limor Fried/Ladyada for Adafruit Industries,
 with contributions from the open source community.
 BSD license, check license.txt for more information
 All text above, and the splash screen below must be
 included in any redistribution.
 **************************************************************************/
#include <Wire.h>
#include <Adafruit_GFX.h>
#include <Adafruit_SSD1306.h>

#define SCREEN_WIDTH 128 // OLED pixel width
#define SCREEN_HEIGHT 64 // OLED pixel height

#define OLED_RESET 4                                                      // Reset pin # (or -1 if sharing Arduino reset pin)
Adafruit_SSD1306 display(SCREEN_WIDTH, SCREEN_HEIGHT, &Wire, OLED_RESET); // Declaration for an SSD1306 display connected to I2C (SDA, SCL pins)

/////////////////////////////////////////////////////////////////////////////////////////////////////////
// Bitmaps                                                                                             //
/////////////////////////////////////////////////////////////////////////////////////////////////////////
const unsigned char PROGMEM tobysoft_2[] = {
    0x00, 0x00, 0x00, 0x00, 0x00, 0x00, 0x00, 0x00, 0x00, 0x00, 0x00, 0x00, 0x00, 0x00, 0x00, 0x00,
    0x02, 0xaa, 0xaa, 0xa0, 0x00, 0x00, 0x00, 0x00, 0x00, 0x00, 0x00, 0x00, 0x00, 0x00, 0x00, 0x00,
    0x00, 0xaa, 0xaa, 0xab, 0xfd, 0x1f, 0xe3, 0xe7, 0xf3, 0xde, 0x7c, 0x3e, 0x7f, 0xbf, 0xc0, 0x00,
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    0x78, 0x1f, 0xff, 0xff, 0xff, 0xfc, 0x00, 0x00, 0x00, 0x00, 0x00, 0x00, 0x00, 0x00, 0x00, 0x00};

static const unsigned char PROGMEM small_lena[] =
    {B00000000, B00000000,
     B01110000, B00000110,
     B01101100, B00000111,
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     B11011000, B00011100};

/////////////////////////////////////////////////////////////////////////////////////////////////////////
// ///////////////                                                                                     //
// END GLOBAL VARS                                                                                     //
// ///////////////                                                                                     //
/////////////////////////////////////////////////////////////////////////////////////////////////////////

void initOLED()
{
    // Get display
    if (!display.begin(SSD1306_SWITCHCAPVCC, 0x3C)) // SSD1306_SWITCHCAPVCC = generate display voltage from 3.3V internally
    {                                               // Address 0x3D for 128x64
        Serial.println(F("SSD1306 allocation failed"));
        for (;;)
            ; // Don't proceed, loop forever
    }

    // Draw unchanging header on display
    displayHeader();
}

/////////////////////////////////////////////////////////////////////////////////////////////////////////
// OLED Display functions                                                                              //
/////////////////////////////////////////////////////////////////////////////////////////////////////////
void displayHeader(void)
{
    display.clearDisplay();
    // Draw TobySoft 2.0 bootscreen
    display.drawBitmap(
        0,
        0,
        tobysoft_2, 128, 64, 1);

    display.display();
    delay(4000); // show for 4 seconds?

    display.clearDisplay();

    // Top bar
    display.fillRect(0, 16, 128, 48, SSD1306_INVERSE);

    // Draw Toby face bmp
    display.drawBitmap(
        (display.width() - 16) / 2,
        0,
        small_lena, 16, 16, 1);

    // L / R text
    display.setTextSize(2);              // Normal 1:1 pixel scale
    display.setTextColor(SSD1306_WHITE); // Draw white text
    display.setCursor(24, 0);            // Start at top-left corner
    display.write('L');
    display.setCursor(96, 0); // Start at top-left corner
    display.write('R');

    // Invert
    display.invertDisplay(true);

    display.display();
}

void updateUltrasonicGraph(void)
{
    // Clear graph area for update
    display.fillRect(0, 16, 128, 48, SSD1306_WHITE);

    // Graph lines
    drawUltrasonicGraphLines();

    display.display();
}

void drawUltrasonicGraphLines(void)
{
    int currentLine = 0;
    for (unsigned int a = 0; a < 8; a++)
    {
        // determine actual currentIndex by reference to historyPointer, overflowing on 8
        int currentIndex = ultrasonicHistoryPointer + a;
        if (currentIndex >= 8)
        {
            currentIndex = 0 + (currentIndex - 8);
        }

        // Get left/right/center width ratios
        float leftWidth = (float)D2_history[currentIndex] / 50;
        if (leftWidth > 1)
        {
            leftWidth = 1;
        }
        float centerWidth = (float)D3_history[currentIndex] / 50;
        if (centerWidth > 1)
        {
            centerWidth = 1;
        }
        float rightWidth = (float)D4_history[currentIndex] / 50;
        if (rightWidth > 1)
        {
            rightWidth = 1;
        }

        // draw L/C/R lines (with rects for thickness)
        display.fillRect(0, 16 + (currentLine * 6), (34 - (34 * leftWidth)), 6, SSD1306_BLACK);                                      // LEFT (0-34)
        display.fillRect((64 - (28 - (28 * centerWidth))), 16 + (currentLine * 6), (28 - (28 * centerWidth)) * 2, 6, SSD1306_BLACK); // CENTER (36-(64)-92)
        display.fillRect(128 - (34 - (34 * rightWidth)), 16 + (currentLine * 6), (34 - (34 * rightWidth)), 6, SSD1306_BLACK);        // RIGHT (94-128)

        currentLine++;
    }
}
