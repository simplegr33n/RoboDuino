//www.elegoo.com

#include <IRremote.h>

//------- IR REMOTE CODES ---------//
#define FWD 16736925         // FORWARD
#define B 16754775           // BACK
#define L 16720605           // LEFT
#define R 16761405           // RIGHT
#define S 16712445           // STOP
#define UNKNOWN_F 5316027    // FORWARD
#define UNKNOWN_B 2747854299 // BACK
#define UNKNOWN_L 1386468383 // LEFT
#define UNKNOWN_R 553536955  // RIGHT
#define UNKNOWN_S 3622325019 // STOP
#define KEY1 16738455
#define KEY2 16750695
#define KEY3 16756815
#define KEY4 16724175
#define KEY5 16718055
#define KEY6 16743045
#define KEY7 16716015
#define KEY8 16726215
#define KEY9 16734885
#define KEY0 16730805
#define KEY_STAR 16728765
#define KEY_HASH 16732845

#define RECV_PIN 12

IRrecv irrecv(RECV_PIN);
decode_results IR_REMOTE_RESULTS;
unsigned long IR_RemoteSignalValue;
unsigned long IR_RemotePreMillis;

///////////////////
// For the music...
///////////////////
#define BUZZER1 A0

// TONES  ==========================================
#include "pitches.h"
bool playTriggered = false;

// Define a special note, 'R', to represent a rest
#define REST 0
#define REST_COUNT 185

#define TEMPO 35000
#define PAUSE 1000 // length of pause between notes

/**************************************************************************
MUSIC and stuff below
 **************************************************************************/

#include <Wire.h>
#include <Adafruit_GFX.h>
#include <Adafruit_SSD1306.h>

#define SCREEN_WIDTH 128 // OLED display width, in pixels
#define SCREEN_HEIGHT 64 // OLED display height, in pixels

// Declaration for an SSD1306 display connected to I2C (SDA, SCL pins)
#define OLED_RESET 4 // Reset pin # (or -1 if sharing Arduino reset pin)
Adafruit_SSD1306 display(SCREEN_WIDTH, SCREEN_HEIGHT, &Wire, OLED_RESET);

#define LOGO_HEIGHT 64
#define LOGO_WIDTH 128
const unsigned char PROGMEM lena_bmp[] = {
    0xff, 0xff, 0xff, 0xff, 0xff, 0xff, 0xff, 0xff, 0xff, 0xff, 0xff, 0xff, 0xff, 0xff, 0xff, 0xff,
    0xff, 0xff, 0xff, 0xff, 0xff, 0xff, 0xff, 0xff, 0xff, 0xff, 0xff, 0xff, 0xff, 0xff, 0xff, 0xff,
    0xff, 0xff, 0xff, 0xff, 0xff, 0xff, 0xff, 0xff, 0xff, 0xff, 0xff, 0xff, 0xff, 0xff, 0xff, 0xff,
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    0x55, 0x00, 0x00, 0x00, 0x15, 0x55, 0x55, 0x55, 0x55, 0x55, 0x55, 0x55, 0x55, 0x55, 0x55, 0x55};

/// MUSIC stuff
// MELODY and TIMING  =======================================
// notes in the melody 1
int melody1[] = {
    NOTE_C3, NOTE_C3, NOTE_C3, NOTE_C3, NOTE_GS3, NOTE_AS3,
    NOTE_C3, NOTE_AS3, NOTE_C3};

// note durations: 1 = 1/16 note, 3 = 3/16 note, etc.:
int beats1[] = {
    1, 1, 1, 3, 3, 3,
    2, 1, 9};

void setup()
{
  Serial.begin(9600);

  irrecv.enableIRIn();

  pinMode(BUZZER1, OUTPUT);

  // SSD1306_SWITCHCAPVCC = generate display voltage from 3.3V internally
  if (!display.begin(SSD1306_SWITCHCAPVCC, 0x3C))
  { // Address 0x3D for 128x64
    Serial.println(("SSD1306 allocation failed"));
    for (;;)
      ; // Don't proceed, loop forever
  }
  displayHeader();
}

void loop()
{
  // REMOTE Decode
  if (irrecv.decode(&IR_REMOTE_RESULTS))
  {
    IR_RemotePreMillis = millis();
    IR_RemoteSignalValue = IR_REMOTE_RESULTS.value;
    Serial.println(IR_RemoteSignalValue);
    irrecv.resume();
    switch (IR_RemoteSignalValue)
    {
    case FWD:
      playTriggered = true;
      break;
    default:
      break;
    }
  }
  else
  {
    if (millis() - IR_RemotePreMillis > 500)
    {
      IR_RemotePreMillis = millis();
    }
  }

  if (playTriggered)
  {
    int n = sizeof(beats1) / 2;
    for (int i = 0; i < n; i++)
    {
      playTone(melody1[i], beats1[i] * 4 * TEMPO);
    }
    playTriggered = false;
  }
}

void displayHeader(void)
{
  display.clearDisplay();

  // Toby face
  display.drawBitmap(
      (display.width() - LOGO_WIDTH) / 2,
      0,
      lena_bmp, LOGO_WIDTH, LOGO_HEIGHT, 1);

  display.display();
}

void rest(long duration)
{
  for (int j = 0; j < REST_COUNT; j++)
  {
    delayMicroseconds(duration);
  }
}

void playTone(long tone_, long duration)
{
  byte state = LOW;
  long elapsed_time = 0;
  if (tone_ > 0)
  {
    tone_ >>= 1;
    while (elapsed_time < duration)
    {
      state = state == HIGH ? LOW : HIGH;
      digitalWrite(BUZZER1, state);
      delayMicroseconds(tone_);
      elapsed_time += tone_;
    }
  }
  else
    rest(duration);
}
