///////////////////
// For the music...
///////////////////
#define BUZZER1 A0
#define BUZZER2 A1

// TONES  ==========================================
#include "pitches.h"
bool playTriggered = false;

// Define a special note, 'R', to represent a rest
#define REST 0
#define REST_COUNT 185

#define TEMPO 35000
#define PAUSE 1000 // length of pause between notes

/**************************************************************************
 This is an example for our Monochrome OLEDs based on SSD1306 drivers

 Pick one up today in the adafruit shop!
 ------> http://www.adafruit.com/category/63_98

 This example is for a 128x64 pixel display using I2C to communicate
 3 pins are required to interface (two I2C and one reset).

 Adafruit invests time and resources providing this open
 source code, please support Adafruit and open-source
 hardware by purchasing products from Adafruit!

 Written by Limor Fried/Ladyada for Adafruit Industries,
 with contributions from the open source community.
 BSD license, check license.txt for more information
 All text above, and the splash screen below must be
 included in any redistribution.
 **************************************************************************/

#include <Wire.h>
#include <Adafruit_GFX.h>
#include <Adafruit_SSD1306.h>

#define SCREEN_WIDTH 128 // OLED display width, in pixels
#define SCREEN_HEIGHT 64 // OLED display height, in pixels

// Declaration for an SSD1306 display connected to I2C (SDA, SCL pins)
#define OLED_RESET 4 // Reset pin # (or -1 if sharing Arduino reset pin)
Adafruit_SSD1306 display(SCREEN_WIDTH, SCREEN_HEIGHT, &Wire, OLED_RESET);

#define LOGO_HEIGHT 64
#define LOGO_WIDTH 128
const unsigned char PROGMEM lena_bmp[] = {
    0xff, 0xff, 0xff, 0xff, 0xff, 0xff, 0xff, 0xff, 0xff, 0xff, 0xff, 0xff, 0xff, 0xff, 0xff, 0xff,
    0xff, 0xff, 0xff, 0xff, 0xff, 0xff, 0xff, 0xff, 0xff, 0xff, 0xff, 0xff, 0xff, 0xff, 0xff, 0xff,
    0xff, 0xff, 0xff, 0xff, 0xff, 0xff, 0xff, 0xff, 0xff, 0xff, 0xff, 0xff, 0xff, 0xff, 0xff, 0xff,
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    0xff, 0x80, 0x00, 0x00, 0x1f, 0xff, 0xff, 0xff, 0xff, 0xff, 0xff, 0xff, 0xff, 0xff, 0xff, 0xff};

void setup()
{
  Serial.begin(9600);

  pinMode(BUZZER1, OUTPUT);
  pinMode(BUZZER2, OUTPUT);

  // SSD1306_SWITCHCAPVCC = generate display voltage from 3.3V internally
  if (!display.begin(SSD1306_SWITCHCAPVCC, 0x3C))
  { // Address 0x3D for 128x64
    Serial.println(F("SSD1306 allocation failed"));
    for (;;)
      ; // Don't proceed, loop forever
  }

  displayHeader();
}

void displayHeader(void)
{
  display.clearDisplay();

  // Toby face
  display.drawBitmap(
      (display.width() - LOGO_WIDTH) / 2,
      0,
      lena_bmp, LOGO_WIDTH, LOGO_HEIGHT, 1);

  display.display();
}

/// MUSIC stuff
// MELODY and TIMING  =======================================

// notes in the melody 1
int melody1[] = {
    NOTE_C3, NOTE_C3, NOTE_C3, NOTE_C3, NOTE_GS3, NOTE_AS3,
    NOTE_C3, NOTE_AS3, NOTE_C3};

// note durations: 1 = 1/16 note, 3 = 3/16 note, etc.:
int beats1[] = {
    1, 1, 1, 3, 3, 3,
    2, 1, 9};

// notes in the melody 2
int melody2[] = {
    NOTE_C2, NOTE_C2, NOTE_C2, NOTE_C4, NOTE_GS4, NOTE_AS4,
    NOTE_C3, NOTE_AS3, NOTE_C2};

void rest(long duration)
{
  for (int j = 0; j < REST_COUNT; j++)
  {
    delayMicroseconds(duration);
  }
}

void playTone(long tone_, long duration)
{
  byte state = LOW;
  long elapsed_time = 0;
  if (tone_ > 0)
  {
    tone_ >>= 1;
    while (elapsed_time < duration)
    {
      state = state == HIGH ? LOW : HIGH;
      digitalWrite(BUZZER1, state);
      delayMicroseconds(tone_);
      elapsed_time += tone_;
    }
  }
  else
    rest(duration);
}

void play2Tones(long tone1, long tone2, long duration)
{
  byte s1, s2; // state of the buzzers
  long sum1, sum2, cur, next, n1, n2;
  cur = next = sum1 = sum2 = 0;

  // Init buzzers
  s1 = s2 = LOW;
  digitalWrite(BUZZER1, s1);
  digitalWrite(BUZZER2, s2);

  if (tone1 > 0 && tone2 > 0)
  {
    duration -= PAUSE;
    tone1 >>= 1;
    tone2 >>= 1;
    while (cur < duration)
    {
      next = min(min(sum1 + tone1, sum2 + tone2), duration);
      delayMicroseconds(next - cur);
      if (sum1 + tone1 == next)
      {
        s1 = s1 == HIGH ? LOW : HIGH;
        digitalWrite(BUZZER1, s1);
        sum1 += tone1;
      }
      if (sum2 + tone2 == next)
      {
        s2 = s2 == HIGH ? LOW : HIGH;
        digitalWrite(BUZZER2, s2);
        sum2 += tone2;
      }
      cur = next;
    }
    delayMicroseconds(PAUSE);
  }
  else if (tone1 > 0 || tone2 > 0)
  {
    // TODO: choose appropriate buzzer
    playTone(tone1 > 0 ? tone1 : tone2, duration);
  }
  else
    rest(duration);
}

void loop()
{
  if (playTriggered)
  {
    if (sizeof(melody1) != sizeof(melody2) || sizeof(melody1) != sizeof(beats1))
    {
      playTone(NOTE_E4, 32 * TEMPO);
      playTone(REST, 16 * TEMPO);
      playTone(NOTE_E4, 16 * TEMPO);
      return;
    }

    int n = sizeof(beats1) / 2;
    for (int i = 0; i < n; i++)
    {
      play2Tones(melody1[i], melody2[i], beats1[i] * 4 * TEMPO);
    }
    playTriggered = false;
  }

  if (digitalRead(12) == 1)
  {
    playTriggered = true;
  }
}
